## tests/openhaystack/testcase.yaml
```yaml
sample:
  name: openhaystack key encoding
tests:
  openhaystack.key_encoding:
    tags: bluetooth openhaystack
    platform_allow:
      - native_sim
    harness: ztest
```
