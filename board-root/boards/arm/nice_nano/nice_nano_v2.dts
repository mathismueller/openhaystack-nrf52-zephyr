/*
 * Vendored from ZMK (commit c06fa48^, pre-HWMv2 layout
 * app/boards/arm/nice_nano/nice_nano_v2.dts). ZMK battery-management
 * nodes (zmk,ext-power-generic / zmk,battery-nrf-vddh) were removed:
 * they require out-of-tree ZMK devicetree bindings unavailable in NCS.
 */

/dts-v1/;
#include "nice_nano.dtsi"

/ {
};
